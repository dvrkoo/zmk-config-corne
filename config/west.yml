## config/west.yml
```yaml
manifest:
  remotes:
    - name: zmkfirmware
      url-base: https://github.com/zmkfirmware
  projects:
    - name: zmk
      remote: zmkfirmware
      revision: v0.2 # Pins to ZMK v0.2 (Stable, Pre-Zephyr 4.1)
      import: app/west.yml
  self:
    path: config
```
